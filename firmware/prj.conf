## CMakeLists.txt
```
cmake_minimum_required(VERSION 3.19)
if(LISTENM_HOST)
  project(listenm-receiver C)
  add_executable(listenm-receiver src/host_main.c src/receiver.c src/sse.c src/pet_net.c)
  target_compile_definitions(listenm-receiver PRIVATE LISTENM_HOST)
  target_compile_options(listenm-receiver PRIVATE -Wall -Wextra -Werror)
  enable_testing()
  add_executable(test-net tests/test_net.c src/pet_net.c)
  target_include_directories(test-net PRIVATE src)
  target_compile_definitions(test-net PRIVATE LISTENM_HOST getaddrinfo=fixture_getaddrinfo freeaddrinfo=fixture_freeaddrinfo)
  target_compile_options(test-net PRIVATE -Wall -Wextra -Werror)
  add_test(NAME net COMMAND test-net)
  add_executable(test-resource-error tests/test_resource_error.c src/pet_resource_error.c)
  target_include_directories(test-resource-error PRIVATE src assets)
  target_compile_options(test-resource-error PRIVATE -Wall -Wextra -Werror)
  add_test(NAME resource-error COMMAND test-resource-error)
  add_executable(test-text tests/test_text.c src/pet_text.c src/pet_pack.c)
  target_include_directories(test-text PRIVATE src)
  target_compile_options(test-text PRIVATE -Wall -Wextra -Werror)
  add_test(NAME text COMMAND test-text ${CMAKE_CURRENT_SOURCE_DIR}/assets/status-font.bin)
  add_executable(test-config tests/test_config.c src/pet_config.c src/pet_storage.c)
  target_compile_definitions(test-config PRIVATE LISTENM_HOST)
  target_include_directories(test-config PRIVATE src)
  target_compile_options(test-config PRIVATE -Wall -Wextra -Werror)
  add_test(NAME config COMMAND test-config)
  add_executable(test-overlay tests/test_overlay.c src/pet_overlay.c src/pet_model.c src/pet_pack.c)
  target_compile_definitions(test-overlay PRIVATE LISTENM_HOST)
  target_include_directories(test-overlay PRIVATE src assets)
  target_compile_options(test-overlay PRIVATE -Wall -Wextra -Werror)
  add_test(NAME overlay COMMAND test-overlay ${CMAKE_CURRENT_SOURCE_DIR}/assets/whale.bin)
  add_executable(test-button tests/test_button.c src/pet_button.c)
  target_include_directories(test-button PRIVATE src)
  target_compile_options(test-button PRIVATE -Wall -Wextra -Werror)
  add_test(NAME button COMMAND test-button)
  add_executable(test-pack tests/test_pack.c src/pet_pack.c src/pet_model.c)
  target_include_directories(test-pack PRIVATE src)
  target_compile_options(test-pack PRIVATE -Wall -Wextra -Werror)
  file(GLOB EXTRA_PACKS "${CMAKE_CURRENT_SOURCE_DIR}/../bridge/assets/*.bin")
  if(EXTRA_PACKS)
    add_test(NAME extra-packs COMMAND test-pack ${EXTRA_PACKS})
  endif()
  add_executable(test-sse tests/test_sse.c src/sse.c)
  target_include_directories(test-sse PRIVATE src)
  add_test(NAME sse COMMAND test-sse)
  add_executable(test-pet tests/test_pet.c src/pet_model.c)
  target_include_directories(test-pet PRIVATE src assets)
  target_compile_options(test-pet PRIVATE -Wall -Wextra -Werror)
  add_test(NAME pet COMMAND test-pet ${CMAKE_CURRENT_SOURCE_DIR}/assets/whale.bin)
else()
  set(BOARD arcs_mini CACHE STRING "Target board")
  find_package(listenai-cmake REQUIRED HINTS $ENV{ARCS_BASE})
  project(listenm-pet C ASM)
  listenai_compile_definitions(LWIP_DNS_SUPPORT_MDNS_QUERIES=1)
  if(BOARD STREQUAL "arcs_mini")
    set(PET_FLASH_BASE "0x30800000")
  elseif(BOARD STREQUAL "arcs_mini3")
    set(PET_FLASH_BASE "0x30600000")
    if(NOT CONFIG_MEM_PSRAM_BASE STREQUAL "0x28300000" OR NOT CONFIG_MEM_PSRAM_SIZE STREQUAL "0x00500000")
      message(FATAL_ERROR "Mini3 requires the SDK AP=3 MiB / CP=5 MiB PSRAM layout")
    endif()
  else()
    message(FATAL_ERROR "Unsupported board: ${BOARD}")
  endif()
  if(NOT CONFIG_ACOMP_WAKEUP OR CONFIG_BOOT OR NOT CONFIG_MEM_FLASH_BASE STREQUAL PET_FLASH_BASE)
    message(FATAL_ERROR "Use scripts/build-firmware.sh with the voice AP/CP layout")
  endif()
  listenai_add_executable(${PROJECT_NAME})
  target_sources(${PROJECT_NAME} PRIVATE src/main.c src/pet_net.c src/receiver.c src/sse.c src/pet_model.c src/pet_ui.c src/pet_overlay.c src/pet_extra.c src/pet_pack.c src/pet_button.c src/pet_storage.c src/pet_config.c src/pet_text.c src/pet_resource_error.c)
  target_sources(${PROJECT_NAME} PRIVATE src/pet_voice.c)
  if(BOARD STREQUAL "arcs_mini3")
    target_sources(${PROJECT_NAME} PRIVATE src/pet_usb.c src/pet_firmware_compat.c)
  endif()
  target_include_directories(${PROJECT_NAME} PRIVATE ${CMAKE_CURRENT_SOURCE_DIR}/assets)
endif()
```

## Kconfig
```
osource "$ARCS_BASE/Kconfig"

config CP_FIRMWARE_COMPAT
    bool "Include CP PSRAM contract for the Mini3 voice AP"
    default y if BOARD_ARCS_MINI3

config CP_FIRMWARE_COMPAT_OFFSET
    hex
    default 0x180
    depends on CP_FIRMWARE_COMPAT
```

## prj.conf
```kconfig
CONFIG_HEAP_SIZE=0xC000
CONFIG_PSRAM_HEAP_SIZE=0x300000
CONFIG_LISA_WIFI=y
CONFIG_WIFI_LWIP_SAME_CORE=y
CONFIG_MAC_MANAGER=y
CONFIG_MAC_MANAGER_MAC_BY_CHIP_ID=y
CONFIG_WIFI_MANAGER=y
CONFIG_LISA_PORTING=y
CONFIG_LISA_OS=y
CONFIG_LOG=y
CONFIG_PRINTF_LOG_REDIRECT=y
# Current SDK boot with GCC 14 requires more than the historical 8 KiB default.
CONFIG_BOOT_FLASH_SIZE=0x10000
CONFIG_MAIN_TASK_STACK_SIZE=12288
CONFIG_BOOT_FEATURES=y
CONFIG_FILE_SYSTEM=y
CONFIG_LSFS=y
CONFIG_CJSON=y
CONFIG_DISK_DRIVER=y

# Arcs-Mini 240x240 ST7789, native RGB565 over SPI0 DMA.
CONFIG_LISA_GPIO_DEVICE=y
CONFIG_LISA_GPIOA=y
CONFIG_LISA_GPIOB=y
CONFIG_LISA_PWM=y
CONFIG_LISA_SPI0=y
CONFIG_LISA_DISPLAY_DEVICE=y
CONFIG_LISA_DISPLAY_PANEL_ST7789P3=y
CONFIG_PANEL_ST7789P3_WIDTH=240
CONFIG_PANEL_ST7789P3_HEIGHT=240
CONFIG_PANEL_ST7789P3_X_OFFSET=0
CONFIG_PANEL_ST7789P3_Y_OFFSET=0
CONFIG_LISA_DISPLAY_BUS_SPI_4WIRE=y
CONFIG_LISA_DISPLAY_COLOR_INVERT=y
CONFIG_MEM_FLASH_SIZE=0x01000000

# Required read-only TF resource storage.
CONFIG_FATFS_FILESYSTEM=y
CONFIG_LSFS_FAT=y
CONFIG_DISK_DRIVER_SDMMC=y

# Resolve normal DNS and .local mDNS bridge names.
CONFIG_LWIP_OPTION_LWIP_DNS=y
```

## mini3-boot.conf
```kconfig
# Mini3 recovery boot: AP voice at 256 KiB, CP application at 6 MiB.
CONFIG_MEM_CONFIG=n
CONFIG_BOOT_AP_ENTRY=0x30040000
CONFIG_BOOT_CP_ENTRY=0x30600000
CONFIG_APPLICATION_ADDRESS=0x30600000
CONFIG_BOOT_FLASH_SIZE=0x40000
CONFIG_BOOT_SECOND_STAGE=y
CONFIG_BOOT_ADB=y
CONFIG_BOOT_ADB_BACKEND_TINYUSB=y
CONFIG_BOOT_ADB_SHELL=y
CONFIG_BOOT_ADB_SYNC=y
CONFIG_ADB_MAX_PAYLOAD_SIZE=4096
CONFIG_BOOT_RECOVERY=y
CONFIG_BOOT_DISPLAY=n
CONFIG_BOOT_POWER_GUARD=y
CONFIG_BOOT_POWER_GUARD_LONG_PRESS_STARTUP=n
CONFIG_BOOT_POWER_GUARD_USB_PIN=8
CONFIG_BOOT_POWER_GUARD_KEY_PIN=4
CONFIG_BOOT_POWER_GUARD_LATCH_PIN=3
CONFIG_BOOT_POWER_GUARD_LED=n
CONFIG_CHERRYUSB_HOST=n
CONFIG_CHERRYUSB_HOST_MUSB_LISA=n
CONFIG_CHERRYUSB_HOST_CDC_ACM=n
CONFIG_CHERRYUSB_HOST_CH34X=n
CONFIG_CHERRYUSB_HOST_HID=n
CONFIG_BOOT_APP_CORE_AP=y
CONFIG_BOOT_EARLY_LOG=y
CONFIG_FREERTOS_STATIC_ALLOCATION_ENABLE=y
CONFIG_CHERRYUSB=n
CONFIG_CHERRYUSB_APP_CLASS=n
CONFIG_CHERRYUSB_DEVICE=n
```

## mini3.conf
```kconfig
# Match SDK res/arcs-mini3/{boot,ap}.bin and apps/arcs-mini/memap.h.
# LS2663: AP owns the first 3 MiB; CP owns the remaining 5 MiB.
CONFIG_MEM_FLASH_BASE=0x30600000
CONFIG_MEM_FLASH_SIZE=0x00400000
CONFIG_MEM_PSRAM_BASE=0x28300000
CONFIG_MEM_PSRAM_SIZE=0x00500000
CONFIG_PSRAM_HEAP_SIZE=0x00480000
CONFIG_MEM_WFRAM_BASE=0x20000080
CONFIG_MEM_WFRAM_SIZE=0x00016F80
CONFIG_MEM_SRAM_BASE=0x20017000
CONFIG_MEM_SRAM_SIZE=0x00029000
# The paired AP uses the IPC environment before shared crypto locks. Without
# it CP places locks at 0x20040008, inside AP IPC data, and Wi-Fi deadlocks.
CONFIG_ARCS_HAL_IPC=y

# ADB device transport; recovery must not depend on TF or network startup.
CONFIG_CHERRYUSB=y
CONFIG_CHERRYUSB_DEVICE=y
CONFIG_CHERRYUSB_DEVICE_SPEED_HS=y
CONFIG_CHERRYUSB_DEVICE_MUSB_LISA=y
CONFIG_CHERRYUSB_DEVICE_TEMPLATE_NONE=y
CONFIG_CHERRYUSB_APP_CLASS=y
CONFIG_ADB=y
CONFIG_ADB_REBOOT=y
CONFIG_ADB_MAX_PAYLOAD_SIZE=4096
# This product exposes an ADB USB device, not USB host peripherals.
CONFIG_CHERRYUSB_HOST=n
CONFIG_CHERRYUSB_HOST_MUSB_LISA=n
CONFIG_CHERRYUSB_HOST_CDC_ACM=n
CONFIG_CHERRYUSB_HOST_CH34X=n
CONFIG_CHERRYUSB_HOST_HID=n
# Keep USB buffers and stacks within CP SRAM; large allocations use PSRAM.
CONFIG_HEAP_SIZE=0xC000
```

## voice.conf
```kconfig
# Paired with the SDK single-mic sample's AP image and resource layout.
CONFIG_MEM_FLASH_BASE=0x30800000
CONFIG_MEM_FLASH_SIZE=0x00800000
CONFIG_MEM_PSRAM_BASE=0x28800000
CONFIG_MEM_PSRAM_SIZE=0x00800000
CONFIG_BOOT=n
CONFIG_BOOT_HART=n
CONFIG_HEAP_SIZE=0x10000
CONFIG_PSRAM_HEAP_SIZE=0x500000
CONFIG_ARCS_HAL_LSF=y
CONFIG_IPC_LSF=y
CONFIG_ARCS_GPDMA_FULL_INIT=y
CONFIG_LISA_DEVICE=y
CONFIG_LISA_AUDIO_DEVICE=y
CONFIG_ACOMP=y
CONFIG_ACOMP_WAKEUP=y
CONFIG_ACOMP_WAKEUP_ALGORITHM_TYPE_SINGLE_MIC=y
CONFIG_BOOT_FEATURES=n
# Match the prebuilt single-mic AP image's memap.h (not current SDK defaults).
CONFIG_MEM_SRAM_BASE=0x20010000
CONFIG_MEM_SRAM_SIZE=0x00030000
CONFIG_MEM_IPC_BASE=0x20040000
CONFIG_MEM_APRAM_BASE=0x20058800
CONFIG_MEM_APRAM_SIZE=0x00057800
CONFIG_LISA_AUDIO_RECORD_BUFFER_SAMPLES=256
```

## src/main.c
```c
#include <stdio.h>
#include <stdbool.h>
#include <string.h>
#include "FreeRTOS.h"
#include "task.h"
#include "event_groups.h"
#include "lisa_wifi.h"
#include "mac_manager.h"
#include "mac_manager_ops.h"
#include "wifi_manager/wifi_manager.h"
#include "net_al.h"
#include "net_def.h"
#include "pet_config.h"
#include "receiver.h"
#include "pet_ui.h"
#include "pet_storage.h"

#include "pet_voice.h"
#include <board.h>
#include <lisa_device.h>
#include <lisa_gpio.h>

#define WIFI_READY 1
#define IP_READY 2
static EventGroupHandle_t network;
static mac_manager_t *mac;
static int8_t get_mac(uint8_t address[6]) { return mac_manager_get(mac, address, 6); }
static void wifi_ready(void) { xEventGroupSetBits(network, WIFI_READY); }
static void dhcp(int vif, bool success, uint32_t ip, uint32_t mask, uint32_t gw, void *arg) {
    (void)vif; (void)mask; (void)gw; (void)arg;
    if (success) {
        printf("[pet] DHCP %u.%u.%u.%u\n", ip & 255, (ip >> 8) & 255, (ip >> 16) & 255, ip >> 24);
        xEventGroupSetBits(network, IP_READY);
    } else xEventGroupClearBits(network, IP_READY);
}
static void connection(wifi_mgr_connection_info_t *info, void *arg) {
    (void)arg;
    if (info->status == WIFI_MGR_STA_CONNECTED) {
        printf("[pet] Wi-Fi associated; starting DHCP\n");
        net_if_up(net_if_get(WIFI_VIF_STA_IDX)); ls_dhcpc_start(WIFI_VIF_STA_IDX);
    } else if (info->status == WIFI_MGR_STA_DISCONNECTED) {
        xEventGroupClearBits(network, IP_READY);
        ls_dhcpc_stop(WIFI_VIF_STA_IDX); net_if_down(net_if_get(WIFI_VIF_STA_IDX));
    }
}
int main(int argc, char **argv) {
    (void)argc; (void)argv;
    lisa_device_t *power=lisa_device_get("gpiob");
    if(!power || lisa_gpio_configure(power,POWER_EN_PIN,LISA_GPIO_CONFIG_OUTPUT_HIGH)) {
        printf("[pet] power hold initialization failed\n");
        return -1;
    }
#if CONFIG_BOARD_ARCS_MINI3
    extern int pet_usb_init(void);
    if(pet_usb_init()) return -1;
#endif
    printf("[pet] listenm receiver boot\n");
    if (pet_storage_init() || pet_config_load()) {
        printf("[pet] TF/config.ini missing or invalid; startup stopped\n");
        if(pet_ui_resource_error()) printf("[pet-ui] error screen task creation failed\n");
        return -1;
    }
    if (pet_ui_init()) { printf("[pet-ui] task creation failed\n"); return -1; }
    network = xEventGroupCreate();
    mac_manager_config_t config = {.random_mac_if_mac_invalid = false};
    mac = mac_manager_init(mac_manager_ops_get()->mem_ops, mac_manager_ops_get()->content_ops, &config);
    if (!network || !mac) return -1;
    net_dhcp_register_status_callback(dhcp, NULL);
    lisa_wifi_ops_t ops = {.custom_mac = get_mac, .init_done = wifi_ready};
    if (lisa_wifi_init(&ops)) return -1;
    xEventGroupWaitBits(network, WIFI_READY, pdFALSE, pdTRUE, portMAX_DELAY);
    if (wifi_mgr_init(wifi_mgr_ops_get()) || wifi_mgr_sta_enable()) return -1;
    wifi_mgr_sta_add_connection_cb(connection, NULL);
    wifi_mgr_sta_config_t ap = {0};
    memcpy(ap.ssid,PET_WIFI_SSID,strlen(PET_WIFI_SSID));
    memcpy(ap.pwd,PET_WIFI_PASSWORD,strlen(PET_WIFI_PASSWORD));
    if (pet_voice_init()) printf("[voice] initialization failed\n");
    static char cursor[96];
    for (;;) {
        if (!(xEventGroupGetBits(network) & IP_READY)) {
            printf("[pet] connecting Wi-Fi\n");
            wifi_mgr_sta_connect(&ap, true);
            xEventGroupWaitBits(network, IP_READY, pdFALSE, pdTRUE, pdMS_TO_TICKS(15000));
        }
        if (xEventGroupGetBits(network) & IP_READY) {
            printf("[pet] connecting bridge %s:%d\n", PET_BRIDGE_IP, PET_BRIDGE_PORT);
            receiver_run(PET_BRIDGE_IP, PET_BRIDGE_PORT, PET_BRIDGE_TOKEN, cursor);
            printf("[pet] stream closed; retrying\n");
        }
        vTaskDelay(pdMS_TO_TICKS(2000));
    }
}
```

## src/host_main.c
```c
#include "receiver.h"
#include <signal.h>
#include <stdlib.h>
#include <unistd.h>
int main(int argc, char **argv) {
    if (argc < 2) return 2;
    signal(SIGPIPE, SIG_IGN);
    char cursor[96] = {0};
    for (;;) {
        receiver_run(argv[1], argc > 2 ? (unsigned)atoi(argv[2]) : 8787,
            getenv("BRIDGE_TOKEN") ? getenv("BRIDGE_TOKEN") : "", cursor);
        sleep(2);
    }
}
```

## src/pet_button.c
```c
#include "pet_button.h"
int pet_button_sample(pet_button *b,int pressed,uint32_t now) {
    if(pressed!=b->raw) { b->raw=pressed; b->changed=now; }
    if(pressed==b->stable || (uint32_t)(now-b->changed)<20) return 0;
    b->stable=pressed;
    if(pressed) { b->armed=1; return 0; }
    if(!b->armed) return 0;
    b->armed=0;
    if(b->has_click && (uint32_t)(now-b->last_click)<320) { b->has_click=0; return 2; }
    b->has_click=1; b->last_click=now; return 1;
}
```

## src/pet_button.h
```c
#ifndef PET_BUTTON_H
#define PET_BUTTON_H
#include <stdint.h>
typedef struct { int raw,stable,armed,has_click; uint32_t changed,last_click; } pet_button;
/* 0: no event, 1: single click, 2: double click; click occurs on release. */
int pet_button_sample(pet_button *b,int pressed,uint32_t now);
#endif
```

## src/pet_config.c
```c
#include "pet_config.h"
#include "pet_storage.h"
#include <string.h>
#include <stdlib.h>
#include <stdio.h>
#include <ctype.h>
#ifndef LISTENM_HOST
#include <lisa_mem.h>
#else
#define lisa_mem_free free
#endif
pet_config pet_settings;
static char *trim(char *s) {
    while(*s==' ' || *s=='\t' || *s=='\r') s++;
    size_t n=strlen(s); while(n && (s[n-1]==' ' || s[n-1]=='\t' || s[n-1]=='\r')) s[--n]=0;
    return s;
}
int pet_config_parse(const char *data,size_t size,pet_config *out) {
    if(!data || !out || !size || size>4096 || memchr(data,0,size)) return -1;
    char text[4097]; memcpy(text,data,size); text[size]=0;
    pet_config c={.bridge_port=8787,.voice_threshold=600};
    struct field { const char *key; char *value; size_t cap; } fields[]={
#define FIELD(x) {#x,c.x,sizeof(c.x)}
        FIELD(bridge_ip),FIELD(bridge_token),FIELD(wifi_ssid),FIELD(wifi_password),
        FIELD(wake_word),FIELD(wake_model),FIELD(wake_wrap)
#undef FIELD
    };
    unsigned seen=0;
    for(char *line=text;line;) {
        char *next=strchr(line,'\n'); if(next) *next++=0;
        char *key=trim(line); line=next;
        if(!*key || *key=='#' || *key==';') continue;
        char *value=strchr(key,'='); if(!value) return -1;
        *value++=0; key=trim(key); value=trim(value);
        for(char *p=value;*p;p++) if((unsigned char)*p<32 || *p==127) return -1;
        unsigned i;
        for(i=0;i<7;i++) if(!strcmp(key,fields[i].key)) {
            if(strlen(value)>=fields[i].cap) return -1;
            strcpy(fields[i].value,value); break;
        }
        if(i==7) {
            if(!strcmp(key,"bridge_port")) i=7;
            else if(!strcmp(key,"voice_threshold")) i=8;
            else return -1;
            if(!*value) return -1;
            for(char *p=value;*p;p++) if(!isdigit((unsigned char)*p)) return -1;
            char *end; unsigned long n=strtoul(value,&end,10);
            if(*end || !n || n>(i==7?65535:32767)) return -1;
            if(i==7) c.bridge_port=(unsigned)n; else c.voice_threshold=(unsigned)n;
        }
        if(seen&(1u<<i)) return -1;
        seen|=1u<<i;
    }
    /* Keep bridge_ip as the backwards-compatible key, accepting DNS names too. */
    size_t length=strlen(c.bridge_ip);
    if(length && c.bridge_ip[length-1]=='.') c.bridge_ip[--length]=0;
    if(!length) return -1;
    int numeric=1;
    for(size_t i=0;i<length;i++) {
        unsigned char ch=(unsigned char)c.bridge_ip[i];
        if(ch>='A' && ch<='Z') c.bridge_ip[i]=(char)(ch-'A'+'a');
        if(!(ch>='0' && ch<='9') && ch!='.') numeric=0;
    }
    if(numeric) {
        const char *ip=c.bridge_ip;
        for(unsigned i=0;i<4;i++) {
            if(!isdigit((unsigned char)*ip) || (*ip=='0' && isdigit((unsigned char)ip[1]))) return -1;
            unsigned n=0;
            while(isdigit((unsigned char)*ip)) { n=n*10+(unsigned)(*ip++-'0'); if(n>255) return -1; }
            if(i<3) { if(*ip++!='.') return -1; } else if(*ip) return -1;
        }
    } else {
        size_t label=0;
        for(size_t i=0;i<=length;i++) {
            char ch=c.bridge_ip[i];
            if(!ch || ch=='.') {
                if(!label || c.bridge_ip[i-1]=='-') return -1;
                label=0;
            } else {
                if(!((ch>='a' && ch<='z') || (ch>='0' && ch<='9') || ch=='-') ||
                   (!label && ch=='-') || ++label>63) return -1;
            }
        }
    }
    if(!c.bridge_token[0] || !c.wifi_ssid[0] || !c.wake_word[0] || !c.wake_model[0] || !c.wake_wrap[0]) return -1;
    *out=c; return 0;
}
int pet_config_load(void) {
    size_t size; char *data=pet_storage_load("config.ini",4096,&size);
    int result=pet_config_parse(data,size,&pet_settings); lisa_mem_free(data); return result;
}
```

## src/pet_config.h
```c
#ifndef PET_CONFIG_H
#define PET_CONFIG_H
#include <stddef.h>
typedef struct {
    char bridge_ip[254],bridge_token[256],wifi_ssid[32],wifi_password[64];
    char wake_word[128],wake_model[96],wake_wrap[96];
    unsigned bridge_port,voice_threshold;
} pet_config;
extern pet_config pet_settings;
int pet_config_parse(const char *data,size_t size,pet_config *out);
int pet_config_load(void);
#define PET_BRIDGE_IP pet_settings.bridge_ip
#define PET_BRIDGE_PORT pet_settings.bridge_port
#define PET_BRIDGE_TOKEN pet_settings.bridge_token
#define PET_WIFI_SSID pet_settings.wifi_ssid
#define PET_WIFI_PASSWORD pet_settings.wifi_password
#define PET_VOICE_THRESHOLD pet_settings.voice_threshold
#endif
```

## src/pet_extra.c
```c
#include "pet_net.h"
#include "pet_extra.h"
#include "pet_config.h"
#include "pet_storage.h"
#include <FreeRTOS.h>
#include <task.h>
#include <lisa_mem.h>
#include <lwip/sockets.h>
#include <lwip/inet.h>
#include <stdio.h>
#include <stdlib.h>
#include <string.h>
#include <errno.h>
static int enabled;
static unsigned generation;
static uint8_t *pending;
static size_t pending_size;
uint8_t *pet_extra_take(int allow,size_t *size) {
    taskENTER_CRITICAL();
    if(enabled!=allow) { enabled=allow; generation++; }
    uint8_t *p=pending; *size=pending_size; pending=NULL;
    taskEXIT_CRITICAL();
    if(!allow && p) { lisa_mem_free(p); p=NULL; }
    return p;
}
static uint8_t *fetch(size_t *length) {
    int fd=socket(AF_INET,SOCK_STREAM,0);
    if(fd<0) { printf("[pet-extra] socket failed errno=%d\n",errno); return NULL; }
    uint8_t *data=NULL;
    const char *stage="resolve";
    int status=0;
    struct timeval timeout={.tv_sec=5};
    setsockopt(fd,SOL_SOCKET,SO_RCVTIMEO,&timeout,sizeof(timeout));
    setsockopt(fd,SOL_SOCKET,SO_SNDTIMEO,&timeout,sizeof(timeout));
    struct sockaddr_in addr={.sin_family=AF_INET,.sin_port=htons(PET_BRIDGE_PORT)};
    if(pet_resolve_ipv4(PET_BRIDGE_IP,&addr.sin_addr)) goto done;
    stage="connect";
    if(connect(fd,(struct sockaddr*)&addr,sizeof(addr))) goto done;
    stage="request";
    char header[1024];
    int n=snprintf(header,sizeof(header),"GET /pet/next-id HTTP/1.0\r\nHost: %s\r\nAuthorization: Bearer %s\r\nConnection: close\r\n\r\n",PET_BRIDGE_IP,PET_BRIDGE_TOKEN);
    if(n<0 || n>=(int)sizeof(header)) goto done;
    for(int sent=0;sent<n;) { int k=send(fd,header+sent,n-sent,0); if(k<=0) goto done; sent+=k; }
    stage="response headers";
    size_t used=0;
    while(used<sizeof(header)-1) {
        if(recv(fd,header+used,1,0)!=1) goto done;
        header[++used]=0;
        if(used>=4 && !memcmp(header+used-4,"\r\n\r\n",4)) break;
    }
    sscanf(header,"HTTP/%*s %d",&status);
    if(status!=200) goto done;
    for(size_t i=0;i<used;i++) if(header[i]>='A' && header[i]<='Z') header[i]+='a'-'A';
    char *len=strstr(header,"\r\ncontent-length: ");
    if(!len || strstr(header,"transfer-encoding:")) goto done;
    unsigned long size=strtoul(len+18,NULL,10);
    if(!size || size>80) goto done;
    stage="response body";
    char name[81];
    for(used=0;used<size;) {
        n=recv(fd,name+used,size-used,0); if(n<=0) goto done; used+=(size_t)n;
    }
    name[size]=0;
    stage="name validation";
    for(size_t i=0;i<size;i++)
        if(!((name[i]>='a' && name[i]<='z') || (name[i]>='0' && name[i]<='9') || name[i]=='_')) goto done;
    /* Pass only the validated name; the render task streams frames from TF. */
    stage="allocation";
    data=lisa_mem_alloc(size+1);
    if(data) { memcpy(data,name,size+1); *length=size; printf("[pet-extra] selected=%s\n",name); }

done:
    if(!data) printf("[pet-extra] fetch failed stage=%s status=%d errno=%d\n",stage,status,errno);
    closesocket(fd); return data;
}
static void worker(void *arg) {
    (void)arg; unsigned idle=0;
    for(;;) {
        vTaskDelay(pdMS_TO_TICKS(1000));
        taskENTER_CRITICAL(); int allow=enabled && !pending; unsigned gen=generation; taskEXIT_CRITICAL();
        if(!allow) { idle=0; continue; }
        if(++idle<20) continue;
        printf("[pet-extra] idle timer elapsed; requesting clip\n");
        idle=0; size_t size=0; uint8_t *data=fetch(&size);
        taskENTER_CRITICAL();
        if(data && enabled && generation==gen && !pending) { pending=data; pending_size=size; data=NULL; }
        taskEXIT_CRITICAL();
        if(data) { printf("[pet-extra] selection discarded after state change\n"); lisa_mem_free(data); }
    }
}
int pet_extra_init(void) { return xTaskCreate(worker,"pet-extra",4096,NULL,tskIDLE_PRIORITY+1,NULL)==pdPASS?0:-1; }
```

## src/pet_extra.h
```c
#ifndef PET_EXTRA_H
#define PET_EXTRA_H
#include <stddef.h>
#include <stdint.h>
int pet_extra_init(void);
/* Renderer takes ownership of a validated, NUL-terminated TF extra name. */
uint8_t *pet_extra_take(int enabled, size_t *size);
#endif
```

## src/pet_firmware_compat.c
```c
#include <stdint.h>
_Static_assert(CONFIG_CP_FIRMWARE_COMPAT_OFFSET == 0x180, "Mini3 AP contract offset");
_Static_assert(CONFIG_MEM_PSRAM_BASE == 0x28300000, "Mini3 CP base");
_Static_assert(CONFIG_MEM_PSRAM_SIZE == 0x00500000, "Mini3 CP size");
__attribute__((section(".cp_firmware_compat"),used,aligned(4)))
const uint32_t pet_cp_psram[2]={CONFIG_MEM_PSRAM_BASE,CONFIG_MEM_PSRAM_SIZE};
```

## src/pet_model.c
```c
#include "pet_model.h"
#include <string.h>
int pet_state_parse(const char *name, pet_state *out) {
    static const char *names[]={"idle","thinking","working","speaking","attention","sleeping","error"};
    if (!name || !out) return -1;
    for (unsigned i=0;i<PET_STATE_COUNT;i++) if (!strcmp(name,names[i])) { *out=(pet_state)i; return 0; }
    return -1;
}
void pet_model_event(pet_model *m, pet_state state) { if (state<PET_STATE_COUNT) m->requested=state; }
int pet_model_tick(pet_model *m, uint32_t now) {
    pet_state next=m->connected ? m->requested : PET_IDLE;
    if (next==m->current) return 0;
    if (m->connected && next!=PET_ERROR && next!=PET_ATTENTION && (uint32_t)(now-m->changed)<700) return 0;
    m->current=next; m->changed=now; return 1;
}
typedef struct { const uint8_t *src; size_t size,pos; unsigned left; int repeat; } rle_reader;
static int next_byte(rle_reader *r,unsigned *value) {
    if(!r->left) {
        if(r->pos>=r->size) return -1;
        unsigned cmd=r->src[r->pos++]; r->repeat=cmd>=128;
        r->left=r->repeat?cmd-127:cmd+1;
        if((r->repeat?1:r->left)>r->size-r->pos) return -1;
    }
    *value=r->src[r->pos];
    if(!r->repeat || r->left==1) r->pos++;
    r->left--; return 0;
}
int pet_frame_decode_scaled(const uint8_t *src, size_t size, const uint8_t *palette,
                            uint16_t *dst, size_t width, size_t height,
                            size_t out_width, size_t out_height, size_t stride) {
    if(!width || !height || !out_width || !out_height || stride<out_width) return -1;
    if(size<4) return -1;
    uint32_t colors=(uint32_t)src[0]|((uint32_t)src[1]<<8)|((uint32_t)src[2]<<16)|((uint32_t)src[3]<<24);
    if(colors>size-4) return -1;
    rle_reader rgb={.src=src+4,.size=colors},alpha={.src=src+4+colors,.size=size-4-colors};
    for(size_t i=0;i<width*height;i++) {
        unsigned idx,a;
        if(next_byte(&rgb,&idx) || next_byte(&alpha,&a)) return -1;
        if(!a) continue;
        unsigned fg=palette[idx*2]|((unsigned)palette[idx*2+1]<<8);
        /* Expand before alpha blending so the backdrop stays at native resolution. */
        size_t x=i%width,y=i/width;
        size_t x0=(x*out_width+width-1)/width;
        size_t x1=((x+1)*out_width+width-1)/width;
        size_t y0=(y*out_height+height-1)/height;
        size_t y1=((y+1)*out_height+height-1)/height;
        for(size_t oy=y0;oy<y1;oy++) for(size_t ox=x0;ox<x1;ox++) {
            size_t pos=oy*stride+ox;
            if(a==255) { dst[pos]=(uint16_t)fg; continue; }
            unsigned bg=dst[pos],inv=255-a;
            unsigned r=(((fg>>11)*a+(bg>>11)*inv)+127)/255;
            unsigned g=((((fg>>5)&63)*a+((bg>>5)&63)*inv)+127)/255;
            unsigned b=(((fg&31)*a+(bg&31)*inv)+127)/255;
            dst[pos]=(uint16_t)((r<<11)|(g<<5)|b);
        }
    }
    return rgb.pos==rgb.size && !rgb.left && alpha.pos==alpha.size && !alpha.left?0:-1;
}

int pet_frame_decode(const uint8_t *src, size_t size, const uint8_t *palette, uint16_t *dst, size_t pixels) {
    return pet_frame_decode_scaled(src,size,palette,dst,pixels,1,pixels,1,pixels);
}
```

## src/pet_model.h
```c
#ifndef PET_MODEL_H
#define PET_MODEL_H
#include <stdint.h>
#include <stddef.h>
typedef enum { PET_IDLE, PET_THINKING, PET_WORKING, PET_SPEAKING, PET_ATTENTION, PET_SLEEPING, PET_ERROR, PET_STATE_COUNT } pet_state;
typedef struct { pet_state requested, current; uint32_t changed; int connected; } pet_model;
int pet_state_parse(const char *name, pet_state *out);
void pet_model_event(pet_model *m, pet_state state);
int pet_model_tick(pet_model *m, uint32_t now);
// WHP2: blend indexed RGB565 + 8-bit alpha PackBits planes over prefilled dst.
int pet_frame_decode(const uint8_t *src, size_t size, const uint8_t *palette, uint16_t *dst, size_t pixels);
int pet_frame_decode_scaled(const uint8_t *src,size_t size,const uint8_t *palette,
                            uint16_t *dst,size_t width,size_t height,
                            size_t out_width,size_t out_height,size_t stride);
#endif
```

## src/pet_net.c
```c
#define _POSIX_C_SOURCE 200809L
#include "pet_net.h"
#include <string.h>
#include <stdio.h>
#ifdef LISTENM_HOST
#include <arpa/inet.h>
#include <netdb.h>
#else
#include <lwip/netdb.h>
#endif
static int resolve_name(const char *host, struct in_addr *address) {
    struct addrinfo hints={0}, *result=NULL;
    hints.ai_family=AF_INET;
    hints.ai_socktype=SOCK_STREAM;
    int error=getaddrinfo(host,NULL,&hints,&result);
    if(error || !result) {
        printf("[pet-net] cannot resolve %s (%d)\n",host,error);
        if(result) freeaddrinfo(result);
        return -1;
    }
    int found=0;
    for(struct addrinfo *p=result;p;p=p->ai_next) {
        if(p->ai_family==AF_INET && p->ai_addr && p->ai_addrlen>=sizeof(struct sockaddr_in)) {
            struct in_addr candidate=((struct sockaddr_in *)p->ai_addr)->sin_addr;
            uint32_t first=ntohl(candidate.s_addr)>>24;
            /* A host resolver can expose its own /etc/hosts loopback entry.
             * Such an address cannot identify the remote bridge device. */
            if(!first || first==127 || first>=224) continue;
            *address=candidate;
            found=1; break;
        }
    }
    freeaddrinfo(result);
    if(found) {
        char ip[16];
        if(inet_ntop(AF_INET,address,ip,sizeof(ip))) printf("[pet-net] %s -> %s\n",host,ip);
    }
    else printf("[pet-net] no usable remote IPv4 for %s\n",host);
    return found?0:-1;
}

int pet_resolve_ipv4(const char *host, struct in_addr *address) {
    if(!host || !*host || !address) return -1;
    if(inet_pton(AF_INET,host,address)==1) return 0;
    if(!resolve_name(host,address)) return 0;
    /* Short names use the network DNS first (including a configured tailnet).
     * Only unresolved short names fall back to link-local multicast DNS. */
    if(!strchr(host,'.') && strlen(host)<=63) {
        char local[70];
        snprintf(local,sizeof(local),"%s.local",host);
        return resolve_name(local,address);
    }
    return -1;
}
```

## src/pet_net.h
```c
#ifndef PET_NET_H
#define PET_NET_H
#ifdef LISTENM_HOST
#include <netinet/in.h>
#else
#include <lwip/inet.h>
#endif
/* Resolve on every new connection; lwIP manages DNS/mDNS cache expiry. */
int pet_resolve_ipv4(const char *host, struct in_addr *address);
#endif
```
